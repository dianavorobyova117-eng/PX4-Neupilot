## src/modules/mc_mrac_control/Kconfig
```kconfig
menuconfig MODULES_MC_MRAC_CONTROL
	bool "mc_mrac_control"
	default n
	---help---
		Enable MRAC-based multicopter rate and thrust control

menuconfig USER_MC_MRAC_CONTROL
	bool "mc_mrac_control running as userspace module"
	default n
	depends on BOARD_PROTECTED && MODULES_MC_MRAC_CONTROL
	---help---
		Put mc_mrac_control in userspace memory
```

## src/modules/proper_acc_control/Kconfig
```kconfig
menuconfig MODULES_PROPER_ACC_CONTROL
	bool "proper_acc_control"
	default n
	---help---
		Enable support for proper_acc_control

menuconfig USER_MC_RATE_CONTROL
	bool "proper_acc_control running as userspace module"
	default n
	depends on BOARD_PROTECTED && MODULES_PROPER_ACC_CONTROL
	---help---
		Put proper_acc_control in userspace memory
```
